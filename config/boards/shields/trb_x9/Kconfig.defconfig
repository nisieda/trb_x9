## dts/bindings/zmk,behavior-mouse-layer-exit.yaml
```yaml
# SPDX-License-Identifier: MIT
description: |
  Turns `layer` off `delay-ms` after the last key bound to this behavior is
  released. Pressing it again before then cancels the turn-off. Meant to be
  combined with mouse buttons (in a macro) inside the auto mouse layer.

compatible: "zmk,behavior-mouse-layer-exit"

include: zero_param.yaml

properties:
  layer:
    type: int
    required: true
    description: Layer index to turn off.
  delay-ms:
    type: int
    default: 300
    description: Delay after release before the layer is turned off.
```

## dts/bindings/zmk,behavior-rotate-step.yaml
```yaml
# SPDX-License-Identifier: MIT
description: |
  Steps the shared trackball rotation angle (see zmk,input-processor-rotate)
  by +-15 degrees each time it is pressed. param1 is the direction:
  1 = clockwise (+15 degrees), -1 = counter-clockwise (-15 degrees).

compatible: "zmk,behavior-rotate-step"

include: one_param.yaml
```

## dts/bindings/zmk,input-processor-rotate.yaml
```yaml
# SPDX-License-Identifier: MIT
description: |
  Rotates relative pointer (trackball) X/Y movement in 15-degree steps.
  There is a single shared rotation state (0-23, each step = 15 degrees)
  used by all instances - adjust it at runtime with the
  zmk,behavior-rotate-step behavior.

compatible: "zmk,input-processor-rotate"

properties:
  "#input-processor-cells":
    type: int
    required: true
    const: 0
  track-remainders:
    type: boolean
    description: |
      Whether to track fractional/remainder movement between events for this
      processor instance. Not used by this processor, but must be declared
      since ZMK's input-listener driver reads this property unconditionally
      for every entry in an input-processors list.

input-processor-cells:
  []
```

## src/Kconfig
```kconfig
# SPDX-License-Identifier: MIT
# Kconfig for trackball 15-degree rotation input processor + behavior

config ZMK_INPUT_PROCESSOR_ROTATE
    bool "Rotate trackball movement in 15-degree steps"
    default y
    depends on ZMK_POINTING
    depends on INPUT
    help
      Enables an input processor that rotates relative X/Y pointer
      movement in 24 discrete 15-degree steps. The current step is
      shared global state, adjustable at runtime via the
      zmk,behavior-rotate-step behavior.

config ZMK_BEHAVIOR_ROTATE_STEP
    bool "Behavior to adjust trackball rotation angle at runtime"
    default y
    depends on ZMK_INPUT_PROCESSOR_ROTATE
    help
      Enables a keymap behavior that steps the trackball rotation
      angle by +-15 degrees (param1 = +1 for clockwise, -1 for
      counter-clockwise) each time it is pressed.
```
